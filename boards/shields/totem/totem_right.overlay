/*
 * Copyright (c) 2022 The ZMK Contributors
 *
 * SPDX-License-Identifier: MIT
 */

#include "totem.dtsi"

&default_transform {
    col-offset = <5>;
};

&kscan0 {
    col-gpios
        = <&xiao_d 8 GPIO_ACTIVE_HIGH>
        , <&xiao_d 9 GPIO_ACTIVE_HIGH>
        , <&xiao_d 10 GPIO_ACTIVE_HIGH>
        , <&xiao_d 5 GPIO_ACTIVE_HIGH>
        , <&xiao_d 4 GPIO_ACTIVE_HIGH>
        ;
};

/*
 * XIAO nRF52840 onboard LED assignments (all LEDs are active-low):
 *   led1 = green (P0.30) — battery level indicator
 *
 * The right half is a BLE peripheral (connects to left, not the host directly),
 * so only battery level indication is relevant here.
 */
/ {
    chosen {
        zmk,battery-level-status-led = &led1;
    };
};
